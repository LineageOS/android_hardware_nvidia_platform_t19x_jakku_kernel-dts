#include "tegra194-p3668-all-p3509-0000.dts"

/ {
	nvidia,dtsfilename = __FILE__;

	firmware {
		android {
			compatible = "android,firmware";
			hardware = "rey";
			boot_devices = "141a0000.pcie,3460000.sdhci,3400000.sdhci";
			vbmeta {
				compatible = "android,vbmeta";
				parts = "vbmeta,boot,kernel-dtb,kernel-dtbo,vbmeta_system,recovery";
			};
		};
	};
};
