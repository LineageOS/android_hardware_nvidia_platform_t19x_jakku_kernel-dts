#include "tegra194-p3668-all-p3509-0000-android.dts"
#include <tegra194-soc/tegra194-drm.dtsi>

/ {
	nvidia,dtsfilename = __FILE__;
};

&sor0 {
	avdd-io-hdmi-dp-supply = <&p3668_spmic_sd0>;
	vdd-hdmi-dp-pll-supply = <&p3668_spmic_sd1>;

	nvidia,dpaux = <&dpaux0>;
};

&sor1 {
	avdd-io-hdmi-dp-supply = <&p3668_spmic_sd0>;
	vdd-hdmi-dp-pll-supply = <&p3668_spmic_sd1>;
	hdmi-supply = <&p3509_vdd_hdmi_5v0>;

	nvidia,ddc-i2c-bus = <&dp_aux_ch1_i2c>;
	nvidia,hpd-gpio = <&tegra_main_gpio TEGRA194_MAIN_GPIO(M, 1)
				 GPIO_ACTIVE_LOW>;
};

&dp_aux_ch1_i2c {
	status = "okay";
};
